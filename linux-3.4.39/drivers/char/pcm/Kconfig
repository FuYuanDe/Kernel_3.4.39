## linux-3.4.39/drivers/net/ethernet/sunxi/eth/rtl8367/Kconfig
```kconfig
config SUNXI_RTL8367
	tristate "rtl8367 driver"
	---help---
          rtl8367 driver
```

## linux-3.4.39/drivers/net/ethernet/sunxi/eth/rtl8370/Kconfig
```kconfig
config SUNXI_RTL8370
	tristate "rtl8370 driver"
	---help---
          rtl8370 driver
```

## linux-3.4.39/drivers/ramreserve/Kconfig
```kconfig
config RAMRESERVE
	tristate "ramreserve driver support"
	help
	  ramreserve driver support
```
